/******************************************************************************
* ASAP2 file: arduino_xcponserial_Teensy_2025b.a2l
* Academic License - for use in teaching, academic research, and meeting
* course requirements at degree granting institutions only. Not for
* government, commercial, or other organizational use.
* Code generation for model "arduino_xcponserial_Teensy_2025b".
* Model version : 20
* Simulink Coder version : 25.2 (R2025b) 28-Jul-2025
* C source code generated on : Thu Apr 02 14:21:07 2026
* Target selection: ert.tlc
* Embedded hardware selection: ARM Compatible->ARM Cortex
* Code generation objectives: Unspecified
* Validation result: Not run
* (add additional file header information here)
******************************************************************************/ ASAP2_VERSION 1 31
/* Version 1.31 */
/begin PROJECT ProjectName "Project Comment Goes Here"
/begin HEADER "Header Comments go here" /end HEADER
/begin MODULE ModuleName "Module Comment Goes Here"
/begin IF_DATA XCP
 /begin PROTOCOL_LAYER 0x0100 0x03E8 0x00C8 0x0000 0x0000 0x0000 0x0000 0x0000 0xFF 0xFFFC BYTE_ORDER_MSB_LAST ADDRESS_GRANULARITY_BYTE OPTIONAL_CMD ALLOC_ODT_ENTRY OPTIONAL_CMD ALLOC_ODT OPTIONAL_CMD ALLOC_DAQ OPTIONAL_CMD FREE_DAQ OPTIONAL_CMD GET_DAQ_RESOLUTION_INFO OPTIONAL_CMD GET_DAQ_PROCESSOR_INFO OPTIONAL_CMD START_STOP_SYNCH OPTIONAL_CMD START_STOP_DAQ_LIST OPTIONAL_CMD SET_DAQ_LIST_MODE OPTIONAL_CMD WRITE_DAQ OPTIONAL_CMD SET_DAQ_PTR OPTIONAL_CMD SHORT_DOWNLOAD OPTIONAL_CMD DOWNLOAD OPTIONAL_CMD SHORT_UPLOAD OPTIONAL_CMD UPLOAD OPTIONAL_CMD SET_MTA /end PROTOCOL_LAYER
 /begin DAQ DYNAMIC 0xFFFF 0x0080 0x00 OPTIMISATION_TYPE_DEFAULT ADDRESS_EXTENSION_FREE IDENTIFICATION_FIELD_TYPE_ABSOLUTE GRANULARITY_ODT_ENTRY_SIZE_DAQ_BYTE 0xFF NO_OVERLOAD_INDICATION /begin TIMESTAMP_SUPPORTED 0x0001 SIZE_DWORD UNIT_1US /end TIMESTAMP_SUPPORTED /begin EVENT "100 ms" "100 ms" 0x0000 DAQ 0xFF 0x01 0x08 0x00 /end EVENT /begin EVENT "200 ms" "200 ms" 0x0001 DAQ 0xFF 0x02 0x08 0x00 /end EVENT /end DAQ
 /begin XCP_ON_SxI 0x0100 0x000E1000 ASYNCH_FULL_DUPLEX_MODE PARITY_NONE ONE_STOP_BIT HEADER_LEN_CTR_BYTE CHECKSUM_BYTE /end XCP_ON_SxI
/end IF_DATA
/begin MOD_PAR "MOD PAR Comment Goes Here" /end MOD_PAR
/begin MOD_COMMON "Mod Common Comment Here" BYTE_ORDER MSB_LAST ALIGNMENT_BYTE 1 ALIGNMENT_WORD 2 ALIGNMENT_LONG 4 ALIGNMENT_FLOAT32_IEEE 4 ALIGNMENT_FLOAT64_IEEE 4 /end MOD_COMMON
/begin CHARACTERISTIC PULSE_AMPLITUDE "" VALUE 0x20000B70 Record_FLOAT32_IEEE 0 arduino_xcponserial_Teensy_2025b_CM_single -3.4E+38 3.4E+38 /end CHARACTERISTIC
/begin CHARACTERISTIC STEP_PARAM "" VALUE 0x20000ED8 Record_UWORD 0 arduino_xcponserial_Teensy_2025b_CM_uint16 0 65535 /end CHARACTERISTIC
/begin CHARACTERISTIC arduino_xcponserial_Teensy_20_P.CONST_AMPLITUDE "" VALUE 0x20000B18 Record_FLOAT32_IEEE 0 arduino_xcponserial_Teensy_2025b_CM_single -3.4E+38 3.4E+38 /end CHARACTERISTIC
/begin CHARACTERISTIC arduino_xcponserial_Teensy_20_P.Delay_InitialCondition "" VALUE 0x20000B58 Record_UWORD 0 arduino_xcponserial_Teensy_2025b_CM_uint16 0 65535 /end CHARACTERISTIC
/begin CHARACTERISTIC arduino_xcponserial_Teensy_20_P.PulseGeneratorAmplitudeTunab_pu "" VALUE 0x20000B50 Record_FLOAT64_IEEE 0 arduino_xcponserial_Teensy_2025b_CM_double -1.7E+308 1.7E+308 /end CHARACTERISTIC
/begin CHARACTERISTIC arduino_xcponserial_Teensy_20_P.PulseGeneratorAmplitudeTunabl_p "" VALUE 0x20000B48 Record_FLOAT64_IEEE 0 arduino_xcponserial_Teensy_2025b_CM_double -1.7E+308 1.7E+308 /end CHARACTERISTIC
/begin CHARACTERISTIC arduino_xcponserial_Teensy_20_P.PulseGeneratorAmplitudeTunable_ "" VALUE 0x20000B40 Record_FLOAT64_IEEE 0 arduino_xcponserial_Teensy_2025b_CM_double -1.7E+308 1.7E+308 /end CHARACTERISTIC
/begin CHARACTERISTIC arduino_xcponserial_Teensy_20_P.SineWave_Amp "" VALUE 0x20000B20 Record_FLOAT64_IEEE 0 arduino_xcponserial_Teensy_2025b_CM_double -1.7E+308 1.7E+308 /end CHARACTERISTIC
/begin CHARACTERISTIC arduino_xcponserial_Teensy_20_P.SineWave_Bias "" VALUE 0x20000B28 Record_FLOAT64_IEEE 0 arduino_xcponserial_Teensy_2025b_CM_double -1.7E+308 1.7E+308 /end CHARACTERISTIC
/begin CHARACTERISTIC arduino_xcponserial_Teensy_20_P.SineWave_NumSamp "" VALUE 0x20000B30 Record_FLOAT64_IEEE 0 arduino_xcponserial_Teensy_2025b_CM_double -1.7E+308 1.7E+308 /end CHARACTERISTIC
/begin CHARACTERISTIC arduino_xcponserial_Teensy_20_P.SineWave_Offset "" VALUE 0x20000B38 Record_FLOAT64_IEEE 0 arduino_xcponserial_Teensy_2025b_CM_double -1.7E+308 1.7E+308 /end CHARACTERISTIC
/begin MEASUREMENT arduino_xcponserial_Teensy_20_B.Counter "" UWORD arduino_xcponserial_Teensy_2025b_CM_uint16 0 0 0 65535 ECU_ADDRESS 0x20001CE4
 /begin IF_DATA XCP
  /begin DAQ_EVENT VARIABLE /begin DEFAULT_EVENT_LIST EVENT 0x0000 /end DEFAULT_EVENT_LIST /end DAQ_EVENT
 /end IF_DATA
/end MEASUREMENT
/begin MEASUREMENT arduino_xcponserial_Teensy_20_B.Pulse "" ULONG arduino_xcponserial_Teensy_2025b_CM_uint32 0 0 0 4294967295 ECU_ADDRESS 0x20001CD8
 /begin IF_DATA XCP
  /begin DAQ_EVENT VARIABLE /begin DEFAULT_EVENT_LIST EVENT 0x0001 /end DEFAULT_EVENT_LIST /end DAQ_EVENT
 /end IF_DATA
/end MEASUREMENT
/begin MEASUREMENT arduino_xcponserial_Teensy_20_B.Sine_Wave "" FLOAT32_IEEE arduino_xcponserial_Teensy_2025b_CM_single 0 0 -3.4E+38 3.4E+38 ECU_ADDRESS 0x20001CDC
 /begin IF_DATA XCP
  /begin DAQ_EVENT VARIABLE /begin DEFAULT_EVENT_LIST EVENT 0x0000 /end DEFAULT_EVENT_LIST /end DAQ_EVENT
 /end IF_DATA
/end MEASUREMENT
/begin MEASUREMENT arduino_xcponserial_Teensy_20_B.constSig "" FLOAT32_IEEE arduino_xcponserial_Teensy_2025b_CM_single 0 0 -3.4E+38 3.4E+38 ECU_ADDRESS 0x20001CE0
 /begin IF_DATA XCP
  /begin DAQ_EVENT VARIABLE /begin DEFAULT_EVENT_LIST EVENT 0x0000 /end DEFAULT_EVENT_LIST /end DAQ_EVENT
 /end IF_DATA
/end MEASUREMENT
/begin MEASUREMENT arduino_xcponserial_Teensy_20_Y.Out1 "" UWORD arduino_xcponserial_Teensy_2025b_CM_uint16 0 0 0 65535 ECU_ADDRESS 0x20001CE8
 /begin IF_DATA XCP
  /begin DAQ_EVENT VARIABLE /begin DEFAULT_EVENT_LIST EVENT 0x0000 /end DEFAULT_EVENT_LIST /end DAQ_EVENT
 /end IF_DATA
/end MEASUREMENT
/begin MEASUREMENT arduino_xcponserial_Teensy_20_Y.Out2 "" FLOAT32_IEEE arduino_xcponserial_Teensy_2025b_CM_single 0 0 -3.4E+38 3.4E+38 ECU_ADDRESS 0x20001CEC
 /begin IF_DATA XCP
  /begin DAQ_EVENT VARIABLE /begin DEFAULT_EVENT_LIST EVENT 0x0000 /end DEFAULT_EVENT_LIST /end DAQ_EVENT
 /end IF_DATA
/end MEASUREMENT
/begin MEASUREMENT arduino_xcponserial_Teensy_20_Y.Out3 "" ULONG arduino_xcponserial_Teensy_2025b_CM_uint32 0 0 0 4294967295 ECU_ADDRESS 0x20001CF0
 /begin IF_DATA XCP
  /begin DAQ_EVENT VARIABLE /begin DEFAULT_EVENT_LIST EVENT 0x0001 /end DEFAULT_EVENT_LIST /end DAQ_EVENT
 /end IF_DATA
/end MEASUREMENT
/begin MEASUREMENT arduino_xcponserial_Teensy_20_Y.Out4 "" FLOAT32_IEEE arduino_xcponserial_Teensy_2025b_CM_single 0 0 -3.4E+38 3.4E+38 ECU_ADDRESS 0x20001CF4
 /begin IF_DATA XCP
  /begin DAQ_EVENT VARIABLE /begin DEFAULT_EVENT_LIST EVENT 0x0000 /end DEFAULT_EVENT_LIST /end DAQ_EVENT
 /end IF_DATA
/end MEASUREMENT
/begin MEASUREMENT arduino_xcponserial_Teensy_2_DW.Delay_DSTATE "" UWORD arduino_xcponserial_Teensy_2025b_CM_uint16 0 0 0 65535 ECU_ADDRESS 0x20001D00
 /begin IF_DATA XCP
  /begin DAQ_EVENT VARIABLE /begin DEFAULT_EVENT_LIST EVENT 0x0000 /end DEFAULT_EVENT_LIST /end DAQ_EVENT
 /end IF_DATA
/end MEASUREMENT
/begin MEASUREMENT arduino_xcponserial_Teensy_2_DW.clockTickCounter "" SLONG arduino_xcponserial_Teensy_2025b_CM_int32 0 0 -2147483648 2147483647 ECU_ADDRESS 0x20001CFC
 /begin IF_DATA XCP
  /begin DAQ_EVENT VARIABLE /begin DEFAULT_EVENT_LIST EVENT 0x0001 /end DEFAULT_EVENT_LIST /end DAQ_EVENT
 /end IF_DATA
/end MEASUREMENT
/begin MEASUREMENT arduino_xcponserial_Teensy_2_DW.counter "" SLONG arduino_xcponserial_Teensy_2025b_CM_int32 0 0 -2147483648 2147483647 ECU_ADDRESS 0x20001CF8
 /begin IF_DATA XCP
  /begin DAQ_EVENT VARIABLE /begin DEFAULT_EVENT_LIST EVENT 0x0000 /end DEFAULT_EVENT_LIST /end DAQ_EVENT
 /end IF_DATA
/end MEASUREMENT
/begin COMPU_METHOD arduino_xcponserial_Teensy_2025b_CM_double "Q = V" RAT_FUNC "%15.10" "" COEFFS 0 1 0 0 0 1 /end COMPU_METHOD
/begin COMPU_METHOD arduino_xcponserial_Teensy_2025b_CM_int32 "Q = V" RAT_FUNC "%10.0" "" COEFFS 0 1 0 0 0 1 /end COMPU_METHOD
/begin COMPU_METHOD arduino_xcponserial_Teensy_2025b_CM_single "Q = V" RAT_FUNC "%8.6" "" COEFFS 0 1 0 0 0 1 /end COMPU_METHOD
/begin COMPU_METHOD arduino_xcponserial_Teensy_2025b_CM_uint16 "Q = V" RAT_FUNC "%5.0" "" COEFFS 0 1 0 0 0 1 /end COMPU_METHOD
/begin COMPU_METHOD arduino_xcponserial_Teensy_2025b_CM_uint32 "Q = V" RAT_FUNC "%10.0" "" COEFFS 0 1 0 0 0 1 /end COMPU_METHOD
/begin RECORD_LAYOUT Record_FLOAT32_IEEE FNC_VALUES 1 FLOAT32_IEEE COLUMN_DIR DIRECT /end RECORD_LAYOUT
/begin RECORD_LAYOUT Record_FLOAT64_IEEE FNC_VALUES 1 FLOAT64_IEEE COLUMN_DIR DIRECT /end RECORD_LAYOUT
/begin RECORD_LAYOUT Record_SLONG FNC_VALUES 1 SLONG COLUMN_DIR DIRECT /end RECORD_LAYOUT
/begin RECORD_LAYOUT Record_ULONG FNC_VALUES 1 ULONG COLUMN_DIR DIRECT /end RECORD_LAYOUT
/begin RECORD_LAYOUT Record_UWORD FNC_VALUES 1 UWORD COLUMN_DIR DIRECT /end RECORD_LAYOUT
/begin GROUP arduino_xcponserial_Teensy_2025b "arduino_xcponserial_Teensy_2025b" /* Root */ ROOT
 /begin REF_CHARACTERISTIC PULSE_AMPLITUDE STEP_PARAM arduino_xcponserial_Teensy_20_P.CONST_AMPLITUDE arduino_xcponserial_Teensy_20_P.Delay_InitialCondition arduino_xcponserial_Teensy_20_P.PulseGeneratorAmplitudeTunab_pu arduino_xcponserial_Teensy_20_P.PulseGeneratorAmplitudeTunabl_p arduino_xcponserial_Teensy_20_P.PulseGeneratorAmplitudeTunable_ arduino_xcponserial_Teensy_20_P.SineWave_Amp arduino_xcponserial_Teensy_20_P.SineWave_Bias arduino_xcponserial_Teensy_20_P.SineWave_NumSamp arduino_xcponserial_Teensy_20_P.SineWave_Offset /end REF_CHARACTERISTIC
 /begin REF_MEASUREMENT arduino_xcponserial_Teensy_20_B.Counter arduino_xcponserial_Teensy_20_B.Pulse arduino_xcponserial_Teensy_20_B.Sine_Wave arduino_xcponserial_Teensy_20_B.constSig arduino_xcponserial_Teensy_20_Y.Out1 arduino_xcponserial_Teensy_20_Y.Out2 arduino_xcponserial_Teensy_20_Y.Out3 arduino_xcponserial_Teensy_20_Y.Out4 arduino_xcponserial_Teensy_2_DW.Delay_DSTATE arduino_xcponserial_Teensy_2_DW.clockTickCounter arduino_xcponserial_Teensy_2_DW.counter /end REF_MEASUREMENT
/end GROUP
/end MODULE
/end PROJECT
/* (add any file trailer comments here) */
/* EOF arduino_xcponserial_Teensy_2025b.a2l*/
