/******************************************************************************
* ASAP2 file: Teensy_Model.a2l
* Academic License - for use in teaching, academic research, and meeting
* course requirements at degree granting institutions only. Not for
* government, commercial, or other organizational use.
* Code generation for model "Teensy_Model".
* Model version : 38
* Simulink Coder version : 25.2 (R2025b) 28-Jul-2025
* C source code generated on : Fri Apr 10 11:17:18 2026
* Target selection: ert.tlc
* Embedded hardware selection: ARM Compatible->ARM Cortex
* Code generation objectives: Unspecified
* Validation result: Not run
* (add additional file header information here)
******************************************************************************/ ASAP2_VERSION 1 31
/* Version 1.31 */
/begin PROJECT ProjectName "Project Comment Goes Here"
/begin HEADER "Header Comments go here" /end HEADER
/begin MODULE ModuleName "Module Comment Goes Here"
/begin IF_DATA XCP
 /begin PROTOCOL_LAYER 0x0100 0x03E8 0x00C8 0x0000 0x0000 0x0000 0x0000 0x0000 0xFF 0xFFFC BYTE_ORDER_MSB_LAST ADDRESS_GRANULARITY_BYTE OPTIONAL_CMD ALLOC_ODT_ENTRY OPTIONAL_CMD ALLOC_ODT OPTIONAL_CMD ALLOC_DAQ OPTIONAL_CMD FREE_DAQ OPTIONAL_CMD GET_DAQ_RESOLUTION_INFO OPTIONAL_CMD GET_DAQ_PROCESSOR_INFO OPTIONAL_CMD START_STOP_SYNCH OPTIONAL_CMD START_STOP_DAQ_LIST OPTIONAL_CMD SET_DAQ_LIST_MODE OPTIONAL_CMD WRITE_DAQ OPTIONAL_CMD SET_DAQ_PTR OPTIONAL_CMD SHORT_DOWNLOAD OPTIONAL_CMD DOWNLOAD OPTIONAL_CMD SHORT_UPLOAD OPTIONAL_CMD UPLOAD OPTIONAL_CMD SET_MTA /end PROTOCOL_LAYER
 /begin DAQ DYNAMIC 0xFFFF 0x0080 0x00 OPTIMISATION_TYPE_DEFAULT ADDRESS_EXTENSION_FREE IDENTIFICATION_FIELD_TYPE_ABSOLUTE GRANULARITY_ODT_ENTRY_SIZE_DAQ_BYTE 0xFF NO_OVERLOAD_INDICATION /begin TIMESTAMP_SUPPORTED 0x0001 SIZE_DWORD UNIT_1US /end TIMESTAMP_SUPPORTED /begin EVENT "1 ms" "1 ms" 0x0000 DAQ 0xFF 0x01 0x06 0x00 /end EVENT /end DAQ
 /begin XCP_ON_SxI 0x0100 0x000E1000 ASYNCH_FULL_DUPLEX_MODE PARITY_NONE ONE_STOP_BIT HEADER_LEN_CTR_BYTE CHECKSUM_BYTE /end XCP_ON_SxI
/end IF_DATA
/begin MOD_PAR "MOD PAR Comment Goes Here" /end MOD_PAR
/begin MOD_COMMON "Mod Common Comment Here" BYTE_ORDER MSB_LAST ALIGNMENT_BYTE 1 ALIGNMENT_WORD 2 ALIGNMENT_LONG 4 ALIGNMENT_FLOAT32_IEEE 4 ALIGNMENT_FLOAT64_IEEE 4 /end MOD_COMMON
/begin CHARACTERISTIC Teensy_Model_P.Footcontrol "Footcontrol" VALUE 0x20000BDB Record_UBYTE 0 Teensy_Model_CM_uint8 0 255 /end CHARACTERISTIC
/begin CHARACTERISTIC Teensy_Model_P.Gain1_Gain "" VALUE 0x20000BDE Record_UBYTE 0 Teensy_Model_CM_ufix8_En6 0 3.984375 /end CHARACTERISTIC
/begin CHARACTERISTIC Teensy_Model_P.Gain2_Gain "" VALUE 0x20000BDF Record_UBYTE 0 Teensy_Model_CM_ufix8_En6 0 3.984375 /end CHARACTERISTIC
/begin CHARACTERISTIC Teensy_Model_P.Gain_Gain "" VALUE 0x20000BE0 Record_UBYTE 0 Teensy_Model_CM_ufix8_En6 0 3.984375 /end CHARACTERISTIC
/begin CHARACTERISTIC Teensy_Model_P.Motor_Enable "Motor_Enable" VALUE 0x20000BD8 Record_BOOLEAN 0 Teensy_Model_CM_boolean 0 1 /end CHARACTERISTIC
/begin CHARACTERISTIC Teensy_Model_P.Motor_Stop "Motor_Stop" VALUE 0x20000BD9 Record_BOOLEAN 0 Teensy_Model_CM_boolean 0 1 /end CHARACTERISTIC
/begin CHARACTERISTIC Teensy_Model_P.Speed_Out "Speed_Out" VALUE 0x20000BDC Record_UBYTE 0 Teensy_Model_CM_uint8 0 255 /end CHARACTERISTIC
/begin CHARACTERISTIC Teensy_Model_P.Status_LED "Status_LED" VALUE 0x20000BDA Record_BOOLEAN 0 Teensy_Model_CM_boolean 0 1 /end CHARACTERISTIC
/begin CHARACTERISTIC Teensy_Model_P.Torq_Out "Torq_Out" VALUE 0x20000BDD Record_UBYTE 0 Teensy_Model_CM_uint8 0 255 /end CHARACTERISTIC
/begin MEASUREMENT Teensy_Model_B.MATLABSystem.rpm_out_sens "" FLOAT64_IEEE Teensy_Model_CM_double 0 0 -1.7E+308 1.7E+308 ECU_ADDRESS 0x20001498 /end MEASUREMENT
/begin MEASUREMENT Teensy_Model_B.MATLABSystem1.rpm_out_sens "" FLOAT64_IEEE Teensy_Model_CM_double 0 0 -1.7E+308 1.7E+308 ECU_ADDRESS 0x20001490 /end MEASUREMENT
/begin MEASUREMENT Teensy_Model_B.MD_Current "MD_Current" UWORD Teensy_Model_CM_uint16 0 0 0 65535 ECU_ADDRESS 0x20001488 /end MEASUREMENT
/begin MEASUREMENT Teensy_Model_B.Torq_Signal "Torq_Signal" UWORD Teensy_Model_CM_uint16 0 0 0 65535 ECU_ADDRESS 0x2000148A /end MEASUREMENT
/begin MEASUREMENT Teensy_Model_B.actSpeed_Motor "actSpeed_Motor" FLOAT32_IEEE Teensy_Model_CM_single 0 0 -3.4E+38 3.4E+38 ECU_ADDRESS 0x20001480 /end MEASUREMENT
/begin MEASUREMENT Teensy_Model_B.actSpeed_Torq "actSpeed_Torq" FLOAT32_IEEE Teensy_Model_CM_single 0 0 -3.4E+38 3.4E+38 ECU_ADDRESS 0x20001484 /end MEASUREMENT
/begin MEASUREMENT Teensy_Model_DW.MATLABSystem.ctr "" SLONG Teensy_Model_CM_int32 0 0 -2147483648 2147483647 ECU_ADDRESS 0x200016C0 /end MEASUREMENT
/begin MEASUREMENT Teensy_Model_DW.MATLABSystem.ctrOld "" SLONG Teensy_Model_CM_int32 0 0 -2147483648 2147483647 ECU_ADDRESS 0x200016C4 /end MEASUREMENT
/begin MEASUREMENT Teensy_Model_DW.MATLABSystem.ctrWrapped "" SLONG Teensy_Model_CM_int32 0 0 -2147483648 2147483647 ECU_ADDRESS 0x200016C8 /end MEASUREMENT
/begin MEASUREMENT Teensy_Model_DW.MATLABSystem.objisempty "" UBYTE Teensy_Model_CM_boolean 0 0 0 1 ECU_ADDRESS 0x200016CC /end MEASUREMENT
/begin MEASUREMENT Teensy_Model_DW.MATLABSystem.resetOld "" FLOAT64_IEEE Teensy_Model_CM_double 0 0 -1.7E+308 1.7E+308 ECU_ADDRESS 0x200016B8 /end MEASUREMENT
/begin MEASUREMENT Teensy_Model_DW.MATLABSystem.speedVec "" FLOAT64_IEEE Teensy_Model_CM_double 0 0 -1.7E+308 1.7E+308 /* Array Size */ ARRAY_SIZE 10 ECU_ADDRESS 0x20001668 /end MEASUREMENT
/begin MEASUREMENT Teensy_Model_DW.MATLABSystem1.ctr "" SLONG Teensy_Model_CM_int32 0 0 -2147483648 2147483647 ECU_ADDRESS 0x200015E8 /end MEASUREMENT
/begin MEASUREMENT Teensy_Model_DW.MATLABSystem1.ctrOld "" SLONG Teensy_Model_CM_int32 0 0 -2147483648 2147483647 ECU_ADDRESS 0x200015EC /end MEASUREMENT
/begin MEASUREMENT Teensy_Model_DW.MATLABSystem1.ctrWrapped "" SLONG Teensy_Model_CM_int32 0 0 -2147483648 2147483647 ECU_ADDRESS 0x200015F0 /end MEASUREMENT
/begin MEASUREMENT Teensy_Model_DW.MATLABSystem1.objisempty "" UBYTE Teensy_Model_CM_boolean 0 0 0 1 ECU_ADDRESS 0x200015F4 /end MEASUREMENT
/begin MEASUREMENT Teensy_Model_DW.MATLABSystem1.resetOld "" FLOAT64_IEEE Teensy_Model_CM_double 0 0 -1.7E+308 1.7E+308 ECU_ADDRESS 0x200015E0 /end MEASUREMENT
/begin MEASUREMENT Teensy_Model_DW.MATLABSystem1.speedVec "" FLOAT64_IEEE Teensy_Model_CM_double 0 0 -1.7E+308 1.7E+308 /* Array Size */ ARRAY_SIZE 10 ECU_ADDRESS 0x20001590 /end MEASUREMENT
/begin MEASUREMENT Teensy_Model_Y.Out4 "" FLOAT32_IEEE Teensy_Model_CM_single 0 0 -3.4E+38 3.4E+38 ECU_ADDRESS 0x20001A6C /end MEASUREMENT
/begin MEASUREMENT Teensy_Model_Y.Out5 "" FLOAT32_IEEE Teensy_Model_CM_single 0 0 -3.4E+38 3.4E+38 ECU_ADDRESS 0x20001A68 /end MEASUREMENT
/begin MEASUREMENT Teensy_Model_Y.Out6 "" UWORD Teensy_Model_CM_uint16 0 0 0 65535 ECU_ADDRESS 0x20001A70 /end MEASUREMENT
/begin MEASUREMENT Teensy_Model_Y.Out7 "" UWORD Teensy_Model_CM_uint16 0 0 0 65535 ECU_ADDRESS 0x20001A72 /end MEASUREMENT
/begin COMPU_METHOD Teensy_Model_CM_boolean "Q = V" RAT_FUNC "%1.0" "" COEFFS 0 1 0 0 0 1 /end COMPU_METHOD
/begin COMPU_METHOD Teensy_Model_CM_double "Q = V" RAT_FUNC "%15.10" "" COEFFS 0 1 0 0 0 1 /end COMPU_METHOD
/begin COMPU_METHOD Teensy_Model_CM_int32 "Q = V" RAT_FUNC "%10.0" "" COEFFS 0 1 0 0 0 1 /end COMPU_METHOD
/begin COMPU_METHOD Teensy_Model_CM_single "Q = V" RAT_FUNC "%8.6" "" COEFFS 0 1 0 0 0 1 /end COMPU_METHOD
/begin COMPU_METHOD Teensy_Model_CM_ufix8_En6 "Q = V*64.000000" RAT_FUNC "%7.6" "" COEFFS 0 64.000000 0 0 0 1.000000 /end COMPU_METHOD
/begin COMPU_METHOD Teensy_Model_CM_uint16 "Q = V" RAT_FUNC "%5.0" "" COEFFS 0 1 0 0 0 1 /end COMPU_METHOD
/begin COMPU_METHOD Teensy_Model_CM_uint8 "Q = V" RAT_FUNC "%3.0" "" COEFFS 0 1 0 0 0 1 /end COMPU_METHOD
/begin RECORD_LAYOUT Record_BOOLEAN FNC_VALUES 1 UBYTE COLUMN_DIR DIRECT /end RECORD_LAYOUT
/begin RECORD_LAYOUT Record_FLOAT32_IEEE FNC_VALUES 1 FLOAT32_IEEE COLUMN_DIR DIRECT /end RECORD_LAYOUT
/begin RECORD_LAYOUT Record_FLOAT64_IEEE FNC_VALUES 1 FLOAT64_IEEE COLUMN_DIR DIRECT /end RECORD_LAYOUT
/begin RECORD_LAYOUT Record_SLONG FNC_VALUES 1 SLONG COLUMN_DIR DIRECT /end RECORD_LAYOUT
/begin RECORD_LAYOUT Record_UBYTE FNC_VALUES 1 UBYTE COLUMN_DIR DIRECT /end RECORD_LAYOUT
/begin RECORD_LAYOUT Record_UWORD FNC_VALUES 1 UWORD COLUMN_DIR DIRECT /end RECORD_LAYOUT
/begin GROUP Teensy_Model "Teensy_Model" /* Root */ ROOT
 /begin REF_CHARACTERISTIC Teensy_Model_P.Footcontrol Teensy_Model_P.Gain1_Gain Teensy_Model_P.Gain2_Gain Teensy_Model_P.Gain_Gain Teensy_Model_P.Motor_Enable Teensy_Model_P.Motor_Stop Teensy_Model_P.Speed_Out Teensy_Model_P.Status_LED Teensy_Model_P.Torq_Out /end REF_CHARACTERISTIC
 /begin REF_MEASUREMENT Teensy_Model_B.MD_Current Teensy_Model_B.Torq_Signal Teensy_Model_B.actSpeed_Motor Teensy_Model_B.actSpeed_Torq Teensy_Model_Y.Out4 Teensy_Model_Y.Out5 Teensy_Model_Y.Out6 Teensy_Model_Y.Out7 /end REF_MEASUREMENT
/end GROUP
/end MODULE
/end PROJECT
/* (add any file trailer comments here) */
/* EOF Teensy_Model.a2l*/
