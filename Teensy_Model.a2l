/******************************************************************************
* ASAP2 file: Teensy_Model.a2l
* Code generation for model "Teensy_Model".
* Model version : 67
* Simulink Coder version : 25.2 (R2025b) 28-Jul-2025
* C source code generated on : Mon Apr 20 08:45:55 2026
* Target selection: ert.tlc
* Embedded hardware selection: ARM Compatible->ARM Cortex
* Code generation objectives: Unspecified
* Validation result: Not run
* (add additional file header information here)
******************************************************************************/ ASAP2_VERSION 1 31
/* Version 1.31 */
/begin PROJECT ProjectName "Project Comment Goes Here"
/begin HEADER "Header Comments go here" /end HEADER
/begin MODULE ModuleName "Module Comment Goes Here"
/begin IF_DATA XCP
 /begin PROTOCOL_LAYER 0x0100 0x03E8 0x00C8 0x0000 0x0000 0x0000 0x0000 0x0000 0xFF 0xFFFC BYTE_ORDER_MSB_LAST ADDRESS_GRANULARITY_BYTE OPTIONAL_CMD ALLOC_ODT_ENTRY OPTIONAL_CMD ALLOC_ODT OPTIONAL_CMD ALLOC_DAQ OPTIONAL_CMD FREE_DAQ OPTIONAL_CMD GET_DAQ_RESOLUTION_INFO OPTIONAL_CMD GET_DAQ_PROCESSOR_INFO OPTIONAL_CMD START_STOP_SYNCH OPTIONAL_CMD START_STOP_DAQ_LIST OPTIONAL_CMD SET_DAQ_LIST_MODE OPTIONAL_CMD WRITE_DAQ OPTIONAL_CMD SET_DAQ_PTR OPTIONAL_CMD SHORT_DOWNLOAD OPTIONAL_CMD DOWNLOAD OPTIONAL_CMD SHORT_UPLOAD OPTIONAL_CMD UPLOAD OPTIONAL_CMD SET_MTA /end PROTOCOL_LAYER
 /begin DAQ DYNAMIC 0xFFFF 0x0080 0x00 OPTIMISATION_TYPE_DEFAULT ADDRESS_EXTENSION_FREE IDENTIFICATION_FIELD_TYPE_ABSOLUTE GRANULARITY_ODT_ENTRY_SIZE_DAQ_BYTE 0xFF NO_OVERLOAD_INDICATION /begin TIMESTAMP_SUPPORTED 0x0001 SIZE_DWORD UNIT_1US /end TIMESTAMP_SUPPORTED /begin EVENT "1 ms" "1 ms" 0x0000 DAQ 0xFF 0x01 0x06 0x00 /end EVENT /begin EVENT "250 ms" "250 ms" 0x0001 DAQ 0xFF 0x19 0x07 0x00 /end EVENT /end DAQ
 /begin XCP_ON_SxI 0x0100 0x000E1000 ASYNCH_FULL_DUPLEX_MODE PARITY_NONE ONE_STOP_BIT HEADER_LEN_CTR_BYTE CHECKSUM_BYTE /end XCP_ON_SxI
/end IF_DATA
/begin MOD_PAR "MOD PAR Comment Goes Here" /end MOD_PAR
/begin MOD_COMMON "Mod Common Comment Here" BYTE_ORDER MSB_LAST ALIGNMENT_BYTE 1 ALIGNMENT_WORD 2 ALIGNMENT_LONG 4 ALIGNMENT_FLOAT32_IEEE 4 ALIGNMENT_FLOAT64_IEEE 4 /end MOD_COMMON
/begin CHARACTERISTIC Teensy_Model_P.Footcontrol "Footcontrol" VALUE 0x20000C06 Record_UBYTE 0 Teensy_Model_CM_uint8 0 255 /end CHARACTERISTIC
/begin CHARACTERISTIC Teensy_Model_P.GPIO_0 "GPIO_0" VALUE 0x20000C00 Record_BOOLEAN 0 Teensy_Model_CM_boolean 0 1 /end CHARACTERISTIC
/begin CHARACTERISTIC Teensy_Model_P.GPIO_1 "GPIO_1" VALUE 0x20000C01 Record_BOOLEAN 0 Teensy_Model_CM_boolean 0 1 /end CHARACTERISTIC
/begin CHARACTERISTIC Teensy_Model_P.GPIO_2 "GPIO_2" VALUE 0x20000C02 Record_BOOLEAN 0 Teensy_Model_CM_boolean 0 1 /end CHARACTERISTIC
/begin CHARACTERISTIC Teensy_Model_P.Gain1_Gain "" VALUE 0x20000C14 Record_UBYTE 0 Teensy_Model_CM_ufix8_En7 0 1.9921875 /end CHARACTERISTIC
/begin CHARACTERISTIC Teensy_Model_P.Gain2_Gain "" VALUE 0x20000C15 Record_UBYTE 0 Teensy_Model_CM_ufix8_En7 0 1.9921875 /end CHARACTERISTIC
/begin CHARACTERISTIC Teensy_Model_P.Gain3_Gain "" VALUE 0x20000C0C Record_FLOAT32_IEEE 0 Teensy_Model_CM_single -3.4E+38 3.4E+38 /end CHARACTERISTIC
/begin CHARACTERISTIC Teensy_Model_P.Gain4_Gain "" VALUE 0x20000C10 Record_FLOAT32_IEEE 0 Teensy_Model_CM_single -3.4E+38 3.4E+38 /end CHARACTERISTIC
/begin CHARACTERISTIC Teensy_Model_P.Gain_Gain "" VALUE 0x20000C16 Record_UBYTE 0 Teensy_Model_CM_ufix8_En7 0 1.9921875 /end CHARACTERISTIC
/begin CHARACTERISTIC Teensy_Model_P.Motor_Enable "Motor_Enable" VALUE 0x20000C03 Record_BOOLEAN 0 Teensy_Model_CM_boolean 0 1 /end CHARACTERISTIC
/begin CHARACTERISTIC Teensy_Model_P.Motor_Stop "Motor_Stop" VALUE 0x20000C04 Record_BOOLEAN 0 Teensy_Model_CM_boolean 0 1 /end CHARACTERISTIC
/begin CHARACTERISTIC Teensy_Model_P.Speed_Out "Speed_Out" VALUE 0x20000C07 Record_UBYTE 0 Teensy_Model_CM_uint8 0 255 /end CHARACTERISTIC
/begin CHARACTERISTIC Teensy_Model_P.Status_LED "Status_LED" VALUE 0x20000C05 Record_BOOLEAN 0 Teensy_Model_CM_boolean 0 1 /end CHARACTERISTIC
/begin CHARACTERISTIC Teensy_Model_P.Torq_Out "Torq_Out" VALUE 0x20000C08 Record_UBYTE 0 Teensy_Model_CM_uint8 0 255 /end CHARACTERISTIC
/begin MEASUREMENT Teensy_Model_B.GPIO_3 "GPIO_3" UWORD Teensy_Model_CM_uint16 0 0 0 65535 ECU_ADDRESS 0x20001B24
 /begin IF_DATA XCP
  /begin DAQ_EVENT VARIABLE /begin DEFAULT_EVENT_LIST EVENT 0x0000 /end DEFAULT_EVENT_LIST /end DAQ_EVENT
 /end IF_DATA
/end MEASUREMENT
/begin MEASUREMENT Teensy_Model_B.GPIO_4 "GPIO_4" UWORD Teensy_Model_CM_uint16 0 0 0 65535 ECU_ADDRESS 0x20001B26
 /begin IF_DATA XCP
  /begin DAQ_EVENT VARIABLE /begin DEFAULT_EVENT_LIST EVENT 0x0000 /end DEFAULT_EVENT_LIST /end DAQ_EVENT
 /end IF_DATA
/end MEASUREMENT
/begin MEASUREMENT Teensy_Model_B.GPIO_5 "GPIO_5" UWORD Teensy_Model_CM_uint16 0 0 0 65535 ECU_ADDRESS 0x20001B28
 /begin IF_DATA XCP
  /begin DAQ_EVENT VARIABLE /begin DEFAULT_EVENT_LIST EVENT 0x0000 /end DEFAULT_EVENT_LIST /end DAQ_EVENT
 /end IF_DATA
/end MEASUREMENT
/begin MEASUREMENT Teensy_Model_B.MD_Current "MD_Current" UWORD Teensy_Model_CM_uint16 0 0 0 65535 ECU_ADDRESS 0x20001B2A
 /begin IF_DATA XCP
  /begin DAQ_EVENT VARIABLE /begin DEFAULT_EVENT_LIST EVENT 0x0000 /end DEFAULT_EVENT_LIST /end DAQ_EVENT
 /end IF_DATA
/end MEASUREMENT
/begin MEASUREMENT Teensy_Model_B.Torq_Signal "Torq_Signal" UWORD Teensy_Model_CM_uint16 0 0 0 65535 ECU_ADDRESS 0x20001B2C
 /begin IF_DATA XCP
  /begin DAQ_EVENT VARIABLE /begin DEFAULT_EVENT_LIST EVENT 0x0000 /end DEFAULT_EVENT_LIST /end DAQ_EVENT
 /end IF_DATA
/end MEASUREMENT
/begin MEASUREMENT Teensy_Model_B.actSpeed_Motor "actSpeed_Motor" FLOAT32_IEEE Teensy_Model_CM_single 0 0 -3.4E+38 3.4E+38 ECU_ADDRESS 0x20001B10
 /begin IF_DATA XCP
  /begin DAQ_EVENT VARIABLE /begin DEFAULT_EVENT_LIST EVENT 0x0000 /end DEFAULT_EVENT_LIST /end DAQ_EVENT
 /end IF_DATA
/end MEASUREMENT
/begin MEASUREMENT Teensy_Model_B.actSpeed_Torq "actSpeed_Torq" FLOAT32_IEEE Teensy_Model_CM_single 0 0 -3.4E+38 3.4E+38 ECU_ADDRESS 0x20001B14
 /begin IF_DATA XCP
  /begin DAQ_EVENT VARIABLE /begin DEFAULT_EVENT_LIST EVENT 0x0000 /end DEFAULT_EVENT_LIST /end DAQ_EVENT
 /end IF_DATA
/end MEASUREMENT
/begin MEASUREMENT Teensy_Model_B.actTemp_48 "actTemp_48" FLOAT32_IEEE Teensy_Model_CM_single 0 0 -3.4E+38 3.4E+38 ECU_ADDRESS 0x20001B18
 /begin IF_DATA XCP
  /begin DAQ_EVENT VARIABLE /begin DEFAULT_EVENT_LIST EVENT 0x0001 /end DEFAULT_EVENT_LIST /end DAQ_EVENT
 /end IF_DATA
/end MEASUREMENT
/begin MEASUREMENT Teensy_Model_B.actTemp_49 "actTemp_49" FLOAT32_IEEE Teensy_Model_CM_single 0 0 -3.4E+38 3.4E+38 ECU_ADDRESS 0x20001B1C
 /begin IF_DATA XCP
  /begin DAQ_EVENT VARIABLE /begin DEFAULT_EVENT_LIST EVENT 0x0001 /end DEFAULT_EVENT_LIST /end DAQ_EVENT
 /end IF_DATA
/end MEASUREMENT
/begin MEASUREMENT Teensy_Model_B.tempSig_raw_48 "" UWORD Teensy_Model_CM_uint16 0 0 0 65535 ECU_ADDRESS 0x20001B22
 /begin IF_DATA XCP
  /begin DAQ_EVENT VARIABLE /begin DEFAULT_EVENT_LIST EVENT 0x0001 /end DEFAULT_EVENT_LIST /end DAQ_EVENT
 /end IF_DATA
/end MEASUREMENT
/begin MEASUREMENT Teensy_Model_B.tempSig_raw_49 "" UWORD Teensy_Model_CM_uint16 0 0 0 65535 ECU_ADDRESS 0x20001B20
 /begin IF_DATA XCP
  /begin DAQ_EVENT VARIABLE /begin DEFAULT_EVENT_LIST EVENT 0x0001 /end DEFAULT_EVENT_LIST /end DAQ_EVENT
 /end IF_DATA
/end MEASUREMENT
/begin COMPU_METHOD Teensy_Model_CM_boolean "Q = V" RAT_FUNC "%1.0" "" COEFFS 0 1 0 0 0 1 /end COMPU_METHOD
/begin COMPU_METHOD Teensy_Model_CM_single "Q = V" RAT_FUNC "%8.6" "" COEFFS 0 1 0 0 0 1 /end COMPU_METHOD
/begin COMPU_METHOD Teensy_Model_CM_ufix8_En7 "Q = V*128.000000" RAT_FUNC "%0.6" "" COEFFS 0 128.000000 0 0 0 1.000000 /end COMPU_METHOD
/begin COMPU_METHOD Teensy_Model_CM_uint16 "Q = V" RAT_FUNC "%5.0" "" COEFFS 0 1 0 0 0 1 /end COMPU_METHOD
/begin COMPU_METHOD Teensy_Model_CM_uint8 "Q = V" RAT_FUNC "%3.0" "" COEFFS 0 1 0 0 0 1 /end COMPU_METHOD
/begin RECORD_LAYOUT Record_BOOLEAN FNC_VALUES 1 UBYTE COLUMN_DIR DIRECT /end RECORD_LAYOUT
/begin RECORD_LAYOUT Record_FLOAT32_IEEE FNC_VALUES 1 FLOAT32_IEEE COLUMN_DIR DIRECT /end RECORD_LAYOUT
/begin RECORD_LAYOUT Record_UBYTE FNC_VALUES 1 UBYTE COLUMN_DIR DIRECT /end RECORD_LAYOUT
/begin RECORD_LAYOUT Record_UWORD FNC_VALUES 1 UWORD COLUMN_DIR DIRECT /end RECORD_LAYOUT
/begin GROUP Teensy_Model "Teensy_Model" /* Root */ ROOT
 /begin REF_CHARACTERISTIC Teensy_Model_P.Footcontrol Teensy_Model_P.GPIO_0 Teensy_Model_P.GPIO_1 Teensy_Model_P.GPIO_2 Teensy_Model_P.Gain1_Gain Teensy_Model_P.Gain2_Gain Teensy_Model_P.Gain3_Gain Teensy_Model_P.Gain4_Gain Teensy_Model_P.Gain_Gain Teensy_Model_P.Motor_Enable Teensy_Model_P.Motor_Stop Teensy_Model_P.Speed_Out Teensy_Model_P.Status_LED Teensy_Model_P.Torq_Out /end REF_CHARACTERISTIC
 /begin REF_MEASUREMENT Teensy_Model_B.GPIO_3 Teensy_Model_B.GPIO_4 Teensy_Model_B.GPIO_5 Teensy_Model_B.MD_Current Teensy_Model_B.Torq_Signal Teensy_Model_B.actSpeed_Motor Teensy_Model_B.actSpeed_Torq Teensy_Model_B.actTemp_48 Teensy_Model_B.actTemp_49 Teensy_Model_B.tempSig_raw_48 Teensy_Model_B.tempSig_raw_49 /end REF_MEASUREMENT
/end GROUP
/end MODULE
/end PROJECT
/* (add any file trailer comments here) */
/* EOF Teensy_Model.a2l*/
